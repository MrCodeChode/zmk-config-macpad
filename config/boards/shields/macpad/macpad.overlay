vol_encoder: encoder_vol {
     compatible = "alps,ec11";
    label = "VOL_ENCODER";
    a-gpios = <&xiao_d 7 (GPIO_ACTIVE_HIGH | GPIO_PULL_UP)>;
    b-gpios = <&xiao_d 8 (GPIO_ACTIVE_HIGH | GPIO_PULL_UP)>;
    steps = <80>;
    status = "enabled";
};

sensors: sensors {
    compatible = "zmk,keymap-sensors";
    sensors = <&vol_encoder>;
    triggers-per-rotation = <20>;
};

/ {
    chosen {
        zmk,kscan = &kscan0;
    };

    kscan0: kscan_0 {
        compatible = "zmk,kscan-gpio-matrix";
        label = "KSCAN";
        diode-direction = "col2row";

        col-gpios
            = <&xiao_d 2 GPIO_ACTIVE_HIGH>
            , <&xiao_d 4 GPIO_ACTIVE_HIGH>
            , <&xiao_d 5 GPIO_ACTIVE_HIGH>
            , <&xiao_d 6 GPIO_ACTIVE_HIGH>
            ;

        row-gpios
            = <&xiao_d 3 (GPIO_ACTIVE_HIGH | GPIO_PULL_DOWN)>
            , <&xiao_d 1 (GPIO_ACTIVE_HIGH | GPIO_PULL_DOWN)>
            , <&xiao_d 0 (GPIO_ACTIVE_HIGH | GPIO_PULL_DOWN)>
            ;
    };
};

&vol_encoder {
    status = "okay";
};
