vol_encoder: encoder_vol {
     compatible = "alps,ec11";
    label = "VOL_ENCODER";
    a-gpios = <&xiao_d 7 (GPIO_ACTIVE_HIGH | GPIO_PULL_UP)>;
    b-gpios = <&xiao_d 8 (GPIO_ACTIVE_HIGH | GPIO_PULL_UP)>;
    steps = <80>;
    status = "enabled";
};

sensors: sensors {
    compatible = "zmk,keymap-sensors";
    sensors = <&vol_encoder>;
    triggers-per-rotation = <20>;
};
